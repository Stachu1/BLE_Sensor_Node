## firmware/N52/boards/oj/bsn_n52/Kconfig.bsn_n52
```kconfig
# BSN-N52 board: nRF52805-CAAA (WLCSP-28)
config BOARD_BSN_N52
	select SOC_NRF52805_CAAA
```

## firmware/N52/boards/oj/bsn_n52/Kconfig.defconfig
```kconfig
if BOARD_BSN_N52

config HW_STACK_PROTECTION
	default ARCH_HAS_STACK_PROTECTION

endif # BOARD_BSN_N52
```

## firmware/N52/boards/oj/bsn_n52/board.yml
```yaml
board:
  name: bsn_n52
  full_name: BSN-N52 BLE Sensor Node (nRF52805)
  socs:
  - name: nrf52805
```
